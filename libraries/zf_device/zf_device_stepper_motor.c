/*********************************************************************************************************************
* 本文件基于逐飞科技 MSPM0G3519 开源库开发
* 
* 文件名称          zf_device_stepper_motor
* 备注信息          步进电机驱动 (ZDT-XS 系列闭环步进电机协议)
********************************************************************************************************************/

#include "zf_device_stepper_motor.h"
#include "zf_driver_uart.h"
#include "timer_config.h"

//-------------------------------------------------------------------------------------------------------------------
// 步进电机初始化
//-------------------------------------------------------------------------------------------------------------------
void stepper_init(void)
{
  // UART3 需要在主函数中初始化
}

//-------------------------------------------------------------------------------------------------------------------
// 发送命令到步进电机 (内部函数)
// 参数: cmd - 命令数据数组, len - 命令长度
//-------------------------------------------------------------------------------------------------------------------
static void stepper_send_cmd(uint8 *cmd, uint8 len)
{
  uint8 i = 0;
  for(i = 0; i < len; i = i + 1)
  {
    uart_write_byte(UART_3, cmd[i]);
  }
}

//-------------------------------------------------------------------------------------------------------------------
// 使能控制
// 参数: addr - 电机地址, state - 1使能/0失能
//-------------------------------------------------------------------------------------------------------------------
void stepper_enable(uint8 addr, uint8 state)
{
  uint8 cmd[6] = {0};
  
  cmd[0] = addr;    // 地址
  cmd[1] = 0xF3;    // 命令码
  cmd[2] = 0xAB;    // 辅助码
  cmd[3] = state;   // 使能状态: 1=使能, 0=失能
  cmd[4] = 0x00;    // 不同步标志
  cmd[5] = 0x6B;    // 校验字节
  
  stepper_send_cmd(cmd, 6);
}

//-------------------------------------------------------------------------------------------------------------------
// 复位电机
// 参数: addr - 电机地址
//-------------------------------------------------------------------------------------------------------------------
void stepper_reset(uint8 addr)
{
  uint8 cmd[4] = {0};
  
  cmd[0] = addr;    // 地址
  cmd[1] = 0x08;    // 命令码
  cmd[2] = 0x97;    // 辅助码
  cmd[3] = 0x6B;    // 校验字节
  
  stepper_send_cmd(cmd, 4);
}

//-------------------------------------------------------------------------------------------------------------------
// 急停
// 参数: addr - 电机地址
//-------------------------------------------------------------------------------------------------------------------
void stepper_stop(uint8 addr)
{
  uint8 cmd[5] = {0};
  
  cmd[0] = addr;    // 地址
  cmd[1] = 0xFE;    // 命令码
  cmd[2] = 0x98;    // 辅助码
  cmd[3] = 0x00;    // 不同步标志
  cmd[4] = 0x6B;    // 校验字节
  
  stepper_send_cmd(cmd, 5);
}

//-------------------------------------------------------------------------------------------------------------------
// 设置当前位置为零点
// 参数: addr - 电机地址
//-------------------------------------------------------------------------------------------------------------------
void stepper_set_pos_zero(uint8 addr)
{
  uint8 cmd[4] = {0};
  
  cmd[0] = addr;    // 地址
  cmd[1] = 0x0A;    // 命令码
  cmd[2] = 0x6D;    // 辅助码
  cmd[3] = 0x6B;    // 校验字节
  
  stepper_send_cmd(cmd, 4);
}

//-------------------------------------------------------------------------------------------------------------------
// 速度模式控制
// 参数: addr - 电机地址
//       dir  - 方向: 0=顺时针(CW), 1=逆时针(CCW)
//       vel  - 速度(RPM): 范围0-5000
//       acc  - 加速度: 范围0-255, 0表示直接启动
//-------------------------------------------------------------------------------------------------------------------
void stepper_vel_control(uint8 addr, uint8 dir, uint16 vel, uint8 acc)
{
  uint8 cmd[8] = {0};
  
  cmd[0] = addr;              // 地址
  cmd[1] = 0xF6;              // 命令码
  cmd[2] = dir;               // 方向: 0=CW, 1=CCW
  cmd[3] = (uint8)(vel >> 8); // 速度高字节
  cmd[4] = (uint8)(vel >> 0); // 速度低字节
  cmd[5] = acc;               // 加速度
  cmd[6] = 0x00;              // 不同步标志
  cmd[7] = 0x6B;              // 校验字节
  
  stepper_send_cmd(cmd, 8);
}

//-------------------------------------------------------------------------------------------------------------------
// 位置模式控制
// 参数: addr - 电机地址
//       dir  - 方向: 0=顺时针(CW), 1=逆时针(CCW)
//       vel  - 速度(RPM): 范围0-5000
//       acc  - 加速度: 范围0-255, 0表示直接启动
//       clk  - 脉冲数: 默认16细分, 3200脉冲=1圈
//       raF  - 运动标志: 0=相对上一输入目标位置, 1=绝对位置, 2=相对当前电机实时位置
//-------------------------------------------------------------------------------------------------------------------
void stepper_pos_control(uint8 addr, uint8 dir, uint16 vel, uint8 acc, uint32 clk, uint8 raF)
{
  uint8 cmd[13] = {0};
  
  cmd[0]  = addr;               // 地址
  cmd[1]  = 0xFD;               // 命令码
  cmd[2]  = dir;                // 方向: 0=CW, 1=CCW
  cmd[3]  = (uint8)(vel >> 8);  // 速度高字节
  cmd[4]  = (uint8)(vel >> 0);  // 速度低字节
  cmd[5]  = acc;                // 加速度
  cmd[6]  = (uint8)(clk >> 24); // 脉冲数 bit24-31
  cmd[7]  = (uint8)(clk >> 16); // 脉冲数 bit16-23
  cmd[8]  = (uint8)(clk >> 8);  // 脉冲数 bit8-15
  cmd[9]  = (uint8)(clk >> 0);  // 脉冲数 bit0-7
  cmd[10] = raF;                // 运动标志: 0=相对上一输入目标位置, 1=绝对位置, 2=相对当前电机实时位置
  cmd[11] = 0x00;               // 不同步标志
  cmd[12] = 0x6B;               // 校验字节
  
  stepper_send_cmd(cmd, 13);
}
//-------------------------------------------------------------------------------------------------------------------
// 电机命令队列
// 状态机逻辑:
// 1. 连续控制命令按电机分别缓存，同一电机在发送前重复设定时，只保留最后一次设定值。
// 2. 一次性位置与回零命令使用先进先出队列，保证例如“设置参数(0xF1)后执行定位(0xFC)”的发送顺序。
// 3. motor_process() 每隔至少 5 ms 只发送一条完整命令，先发送一次性队列，再轮询连续控制缓存。

//-------------------------------------------------------------------------------------------------------------------
// 函数简介     立即触发步进电机回零
// 参数说明     addr：电机地址。
// 参数说明     origin_mode：回零模式，0=单圈就近，1=单圈方向，2=多圈碰撞，3=多圈限位。
//-------------------------------------------------------------------------------------------------------------------
void stepper_origin_trigger_return(uint8 addr, uint8 origin_mode)
{
  uint8 cmd[5] = {0};  // 回零触发完整协议命令。

  cmd[0] = addr;         // 电机地址。
  cmd[1] = 0x9A;         // 回零触发命令码。
  cmd[2] = origin_mode;  // 回零模式。
  cmd[3] = 0;            // 不同步标志。
  cmd[4] = 0x6B;         // 校验字节。

  stepper_send_cmd(cmd, 5);
}//-------------------------------------------------------------------------------------------------------------------
static uint8 motor_cmd_data[2][13];          // 连续控制缓存: 第 0-3 行分别对应地址 0x01-0x04，单条命令最大 13 字节
static uint8 motor_cmd_len[2];               // 连续控制缓存中各电机当前命令的有效长度，单位: 字节
static uint8 motor_cmd_pending_flag[2];      // 连续控制缓存待发送标志: 0=该电机无待发送命令, 1=该电机有待发送命令
static uint8 motor_one_shot_cmd_data[8][13]; // 一次性命令环形 FIFO 的数据区: 共 8 个槽位，单条命令最大 13 字节
static uint8 motor_one_shot_cmd_len[8];      // 一次性命令环形 FIFO 中各槽位的有效命令长度，单位: 字节
static uint8 motor_one_shot_read_index;      // FIFO 读指针: 指向最早且尚未发送的命令槽位，范围: 0-7
static uint8 motor_one_shot_write_index;     // FIFO 写指针: 指向下一条命令应写入的空槽位，范围: 0-7
static uint8 motor_one_shot_cmd_count;       // FIFO 当前有效命令数量: 0=空, 8=已满
static uint32 motor_last_send_time;          // 最近一次完整命令发送结束时记录的系统时间，单位: ms
static uint8 motor_send_index;               // 连续控制轮询起点: 每次发送后改为下一个电机，避免某一电机长期优先
//-------------------------------------------------------------------------------------------------------------------
// 函数简介     将协议中的电机地址换算为连续控制缓存的数组下标
// 参数说明     addr - 协议第 0 字节的电机地址，调用者必须传入 0x01-0x04
// 返回参数     缓存数组下标: 0x01->0, 0x02->1, 0x03->2, 0x04->3
// 使用说明     返回值可直接用于 motor_cmd_data[index]、motor_cmd_len[index] 和待发送标志数组。
// 注意事项     本函数不处理非法地址；除 0x01、0x02、0x03 外的地址都会映射为 3，因此调用处必须保证地址正确。
//-------------------------------------------------------------------------------------------------------------------
static uint8 motor_addr_to_index(uint8 addr)
{
  if(addr == 0x01)
    return 0;
  return 1;
}

//-------------------------------------------------------------------------------------------------------------------
// 函数简介     保存某一电机的最新连续控制命令，等待 motor_process() 异步发送
// 参数说明     cmd - 完整协议帧；cmd[0] 是电机地址，其余字节是命令字和参数
// 参数说明     len - 协议帧有效长度，单位: 字节
// 状态机逻辑:
// 1. 先由 cmd[0] 找到该电机独占的缓存行；不同电机的命令不会互相覆盖。
// 2. 将新命令完整复制到该缓存行，并将待发送标志置为 1。
// 3. 若同一电机尚未发送又收到新命令，新命令会覆盖旧命令；例如先后设置 20、30、40 RPM，最终只发送 40 RPM。
// 使用场景     用于允许“只执行最新值”的连续控制命令，避免主循环积压过期速度或状态设定。
//-------------------------------------------------------------------------------------------------------------------
static void motor_save_cmd(const uint8 *cmd, uint8 len)
{
  uint8 index = motor_addr_to_index(cmd[0]);  // 根据协议帧第 0 字节的地址，选中对应电机的独立缓存行
  uint8 i = 0;                                // 逐字节复制协议帧时使用的数组下标

  motor_cmd_len[index] = len;                 // 记录本次命令的有效字节数，发送时只发送这部分
  for(i = 0; i < len; i = i + 1)
    motor_cmd_data[index][i] = cmd[i];        // 覆盖保存该电机上一条未发送的连续控制命令
  motor_cmd_pending_flag[index] = 1;          // 通知 motor_process()：该电机已有最新命令等待发送
}
//-------------------------------------------------------------------------------------------------------------------
// 函数简介     将必须按调用顺序执行的一次性位置或回零命令写入环形 FIFO
// 参数说明     cmd - 完整协议帧，例如设置快速位置参数的 0xF1 命令或执行快速定位的 0xFC 命令
// 参数说明     len - 协议帧有效长度，单位: 字节
// 状态机逻辑:
// 1. write_index 指向当前可写槽位；新命令写入后，写指针向后移动一格。
// 2. 写指针达到槽位 7 后再加一会回到 0，因此 8 个槽位可循环使用。
// 3. count 记录当前已写入但未发送的命令数量；motor_process() 从 read_index 读取最早一条并减少 count。
// 4. 队列已满时直接丢弃本次新命令，保留先前尚未发送的 8 条命令，绝不覆盖旧命令。
// 使用原因     例如 0xF1 后必须紧接 0xFC；若像连续命令那样覆盖保存，0xFC 会覆盖 0xF1，导致参数没有先发送。
//-------------------------------------------------------------------------------------------------------------------
static void motor_save_one_shot_cmd(const uint8 *cmd, uint8 len)
{
  uint8 i = 0;  // 逐字节复制协议帧时使用的数组下标

  if(motor_one_shot_cmd_count >= 8)
    return;     // FIFO 已满: 本次命令不写入，优先保护队列中较早的命令顺序

  motor_one_shot_cmd_len[motor_one_shot_write_index] = len;  // 在写指针所指槽位记录新命令长度
  for(i = 0; i < len; i = i + 1)
    motor_one_shot_cmd_data[motor_one_shot_write_index][i] = cmd[i];  // 将新命令写入 FIFO 尾部
  motor_one_shot_write_index = motor_one_shot_write_index + 1;        // 写指针移到下一空槽位
  if(motor_one_shot_write_index >= 8)
    motor_one_shot_write_index = 0;                                    // 到达末尾后回绕到第 0 个槽位
  motor_one_shot_cmd_count = motor_one_shot_cmd_count + 1;             // 队列有效命令数加一，等待 motor_process() 取走
}

//-------------------------------------------------------------------------------------------------------------------
// 函数简介     电机命令队列发送服务函数；必须在主循环中持续调用，本函数本身不生成任何电机命令
// 状态机逻辑:
// 1. 距离上一条命令发送未满 5 ms 时不发送，避免电机协议帧间隔过短。
// 2. 已满 5 ms 时优先发送一次性 FIFO 中最早的一条命令，保证位置与回零操作的调用顺序。
// 3. 一次性 FIFO 为空时，按 motor_send_index 开始轮询 4 个电机的连续控制缓存，每次只发送一条最新命令。
// 4. 命令发送后立即更新时间并 return；因此一次调用最多发送一帧，其余命令等待后续主循环再次调用。
//-------------------------------------------------------------------------------------------------------------------
void motor_process(void)
{
  uint8 i = 0;          // 从当前轮询起点开始检查连续控制缓存时的偏移次数
  uint8 index = 0;      // 本次检查到的连续控制缓存行号，对应电机地址 0x01-0x04
  uint8 len = 0;        // 本次要发送的完整协议帧长度，单位: 字节
  uint8 j = 0;          // 逐字节调用 uart_write_byte() 时使用的协议帧下标

  if(get_system_time_ms() - motor_last_send_time >= 5)
  {
    if(motor_one_shot_cmd_count > 0)
    {
      len = motor_one_shot_cmd_len[motor_one_shot_read_index];  // 取出 FIFO 队首，即最早保存的一条一次性命令
      for(j = 0; j < len; j = j + 1)
        uart_write_byte(UART_3, motor_one_shot_cmd_data[motor_one_shot_read_index][j]);  // 将这一帧逐字节发送到电机 UART
      motor_one_shot_read_index += 1;  														// 队首命令已发送，读指针移动到下一条命令
      if(motor_one_shot_read_index >= 8)
        motor_one_shot_read_index = 0;                            // 读指针到末尾后回绕，保持环形 FIFO
      motor_one_shot_cmd_count -= 1;   														// 已发送一条，FIFO 中的有效命令数减一
      motor_last_send_time = get_system_time_ms();                // 记录发送时刻，下一条命令需至少等待 5 ms
      return;                                                     // 本轮只发送一帧，避免连续占用 UART 发送时间
    }

    for(i = 0; i < 2; i++)
    {
      index = (motor_send_index + i) % 2;  // 从上次发送电机的下一个电机开始，依次检查 4 行连续控制缓存
      if(motor_cmd_pending_flag[index] == 1)
      {
        len = motor_cmd_len[index];        // 取出该电机最新连续控制命令的有效长度
        for(j = 0; j < len; j++)
          uart_write_byte(UART_3, motor_cmd_data[index][j]);  // 将该电机最新命令逐字节发送到电机 UART
        motor_cmd_pending_flag[index] = 0;  // 当前缓存命令已发送，清除待发送标志；下次只有新命令才会再次发送
        motor_send_index = (index + 1) % 2; // 下次从下一电机开始检查，避免地址较小的电机持续抢占发送机会
        motor_last_send_time = get_system_time_ms();           // 记录发送时刻，下一条命令需至少等待 5 ms
        return;                                                 // 本轮只发送一帧，其余连续命令留待后续主循环处理
      }
    }
    motor_send_index = 0;  // 当前没有任何连续命令等待发送，下次轮询从地址 0x01 对应的第 0 行开始
  }
}

//-------------------------------------------------------------------------------------------------------------------
// 函数简介     设置电机速度模式命令
// 参数说明     addr - 电机地址
// 参数说明     dir - 方向: 0=顺时针, 1=逆时针
// 参数说明     vel - 速度，单位: RPM，范围: 0-5000
// 参数说明     acc - 加速度，范围: 0-255，0 表示直接启动
//-------------------------------------------------------------------------------------------------------------------
void motor_vel_control(uint8 addr, uint8 dir, uint16 vel, uint8 acc)
{
  uint8 cmd[8] = {0};  // 速度模式完整协议命令

  cmd[0] = addr;
  cmd[1] = 0xF6;
  cmd[2] = dir;
  cmd[3] = (uint8)(vel >> 8);
  cmd[4] = (uint8)(vel >> 0);
  cmd[5] = acc;
  cmd[6] = 0;
  cmd[7] = 0x6B;

  motor_save_cmd(cmd, 8);
}

//-------------------------------------------------------------------------------------------------------------------
// 函数简介     设置电机使能状态
// 参数说明     addr - 电机地址
// 参数说明     state - 使能状态: 0=失能, 1=使能
//-------------------------------------------------------------------------------------------------------------------
void motor_enable(uint8 addr, uint8 state)
{
  uint8 cmd[6] = {0};  // 使能控制完整协议命令

  cmd[0] = addr;
  cmd[1] = 0xF3;
  cmd[2] = 0xAB;
  cmd[3] = state;
  cmd[4] = 0;
  cmd[5] = 0x6B;

  motor_save_cmd(cmd, 6);
}

//-------------------------------------------------------------------------------------------------------------------
// 函数简介     设置电机急停命令
// 参数说明     addr - 电机地址
//-------------------------------------------------------------------------------------------------------------------
void motor_stop(uint8 addr)
{
  uint8 cmd[5] = {0};  // 急停完整协议命令

  cmd[0] = addr;
  cmd[1] = 0xFE;
  cmd[2] = 0x98;
  cmd[3] = 0;
  cmd[4] = 0x6B;

  motor_save_cmd(cmd, 5);
}

//-------------------------------------------------------------------------------------------------------------------
// 函数简介     设置电机位置模式命令
// 参数说明     addr - 电机地址
// 参数说明     dir - 方向: 0=顺时针, 1=逆时针
// 参数说明     vel - 速度，单位: RPM，范围: 0-5000
// 参数说明     acc - 加速度，范围: 0-255，0 表示直接启动
// 参数说明     clk - 脉冲数，范围: 0-4294967295
// 参数说明     raF - 运动标志: 0=相对上一输入目标位置, 1=绝对位置, 2=相对当前电机实时位置
//-------------------------------------------------------------------------------------------------------------------
void motor_pos_control(uint8 addr, uint8 dir, uint16 vel, uint8 acc, uint32 clk, uint8 raF)
{
  uint8 cmd[13] = {0};  // 位置模式完整协议命令

  cmd[0] = addr;
  cmd[1] = 0xFD;
  cmd[2] = dir;
  cmd[3] = (uint8)(vel >> 8);
  cmd[4] = (uint8)(vel >> 0);
  cmd[5] = acc;
  cmd[6] = (uint8)(clk >> 24);
  cmd[7] = (uint8)(clk >> 16);
  cmd[8] = (uint8)(clk >> 8);
  cmd[9] = (uint8)(clk >> 0);
  cmd[10] = raF;
  cmd[11] = 0;
  cmd[12] = 0x6B;

  motor_save_cmd(cmd, 13);
}

//-------------------------------------------------------------------------------------------------------------------
// 函数简介     设置快速位置模式运动参数
// 参数说明     addr - 电机地址
// 参数说明     vel - 速度，单位: RPM，范围: 0-5000
// 参数说明     acc - 加速度，范围: 0-255，0 表示直接启动
// 参数说明     raF - 运动标志: 0=相对上一输入目标位置, 1=绝对位置, 2=相对当前电机实时位置
//-------------------------------------------------------------------------------------------------------------------
void motor_origin_set_o(uint8 addr, uint8 store_flag)
{
  uint8 cmd[5] = {0};  // 单圈回零零点设置完整协议命令

  cmd[0] = addr;
  cmd[1] = 0x93;
  cmd[2] = 0x88;
  cmd[3] = store_flag;
  cmd[4] = 0x6B;

  motor_save_one_shot_cmd(cmd, 5);
}

//-------------------------------------------------------------------------------------------------------------------
// 函数简介     触发电机回零
// 参数说明     addr - 电机地址
// 参数说明     origin_mode - 回零模式: 0=单圈就近, 1=单圈方向, 2=多圈碰撞, 3=多圈限位
//-------------------------------------------------------------------------------------------------------------------
void motor_origin_trigger_return(uint8 addr, uint8 origin_mode)
{
  uint8 cmd[5] = {0};  // 回零触发完整协议命令

  cmd[0] = addr;
  cmd[1] = 0x9A;
  cmd[2] = origin_mode;
  cmd[3] = 0;
  cmd[4] = 0x6B;

  motor_save_one_shot_cmd(cmd, 5);
}
